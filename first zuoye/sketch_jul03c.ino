char Morse[][4]={
{'*','-',' ',' '},
{'-','*','*','*'}, 
{'-','*','-','*'},
{'-','*','*',' '}, 
{'*',' ',' ',' '},
{'*','*','-','*'}, 
{'-','-','*',' '}, 
{'*','*','*','*'}, 
{'*','*',' ',' '},
{'*','-','-','-'}, 
{'-','*','-',' '}, 
{'*','-','*','*'}, 
{'-','-',' ',' '}, 
{'-','*',' ',' '}, 
{'-','-','-',' '}, 
{'*','-','-','*'}, 
{'-','-','*','-'}, 
{'*','-','*',' '},
{'*','*','*',' '}, 
{'-',' ',' ',' '},
{'*','*','-',' '}, 
{'*','*','*','-'}, 
{'*','-','-',' '},
{'-','*','*','-'}, 
{'-','*','-','-'}, 
{'-','-','*','*'},
};
void setup()
{
    Serial.begin(9600);
}

void loop()
{
  String str = "";
  String morse = "";
  int t,i,temp = 0;
  int n = 0; 
  while(Serial.available())
  {
    temp = 1;
    str + = char(Serial.read());
    n++;
    delay(2);
    }
 
  if(temp)
  {
    for(i = 0; i < n; i++)
    {
      for (t = 0;t < 4;t++)
      {
       morse += char(Morse[int(str[i]-97)][t]); 
      }
      morse +=' ';
    }
    Serial.println(morse);
  }
    delay(2);
}
